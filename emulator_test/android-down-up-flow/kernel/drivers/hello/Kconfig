## emulator_test/android-down-up-flow/kernel/drivers/hello/Kconfig
```kconfig
#
# Headset device configuration
#

menu "my hello"

config HELLO
	tristate "First Android Driver"
	---help---
	    First Android Driver	

endmenu
```
